#include <arch/arch.h>

ENTRY(start)

SECTIONS {
	. = 0x0;
	rel_start = .;          /* relative start symbol for components */

	.text : {
		*(BOOTSTRAP);
		*(.text);
	}
	. = 0x8000;
	.data : {
		bdata_start = .;
		*(.data*);      /* initialized data */
		*(.rodata*);
		*(.bss);        /* uninitialized static variables */
		*(COMMON);      /* global variables */
[[COMPONENTS]]
		bdata_end = .;
	}

	/DISCARD/ : {
		*(*);
	}
}
