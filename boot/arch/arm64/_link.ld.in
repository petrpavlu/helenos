#include <arch/arch.h>

ENTRY(start)

SECTIONS {
	. = 0x0;
	.text : {
		loader_start = .;
		*(BOOTSTRAP);
		*(.text);
	}
	. = 0x8000;
	.data : {
		*(.data*);      /* initialized data */
		*(.rodata*);
		*(.bss);        /* uninitialized static variables */
		*(COMMON);      /* global variables */
		loader_end = .;
		payload_start = .;
		*(.payload);
		payload_end = .;
	}

	/DISCARD/ : {
		*(*);
	}
}
